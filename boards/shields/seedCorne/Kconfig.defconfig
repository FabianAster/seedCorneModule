## boards/shields/seedCorne/Kconfig.defconfig
```kconfig
if SHIELD_SEED_CORNE_LEFT

# Name must be less than 16 characters long!
config ZMK_KEYBOARD_NAME
    default "Seed Corne"

config ZMK_SPLIT_ROLE_CENTRAL
    default y

endif

if SHIELD_SEED_CORNE_LEFT || SHIELD_SEED_CORNE_RIGHT

config ZMK_SPLIT
    default y

endif
```

## boards/shields/seedCorne/Kconfig.shield
```kconfig
# No whitespace after the comma or in your part name!
config SHIELD_SEED_CORNE_LEFT
    def_bool $(shields_list_contains,seedCorne_left)

# No whitespace after the comma or in your part name!
config SHIELD_SEED_CORNE_RIGHT
    def_bool $(shields_list_contains,seedCorne_right)
```
